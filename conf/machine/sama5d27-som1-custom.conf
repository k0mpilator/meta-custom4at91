## conf/machine/sama5d27-som1-custom.conf
```bitbake
#@TYPE: Machine
#@Name: ATMEL SAMA5D2 CUSTOM BOARD
#@DESCRIPTION: Machine configuration for Atmel/Microchip's evaluation board

require include/sama5d2.inc

MACHINE_FEATURES = "apm alsa"
KERNEL_DEVICETREE = " \
		at91-sama5d27_som1_ibis.dtb \
		"

IMAGE_FSTYPES += " ubi tar.gz"
MKUBIFS_ARGS = " -e 0x1f000 -c 2048 -m 0x800 -x lzo"
UBINIZE_ARGS = " -m 0x800 -p 0x20000 -s 2048"
UBI_VOLNAME = "ubi"

#IMAGE_BOOT_FILES = "BOOT.BIN u-boot.bin uboot.env sama5d27_som1_custom.dtb sama5d27_som1_custom.itb\
#                    "

UBOOT_MACHINE ?= "sama5d27_ibis_qspiflash_defconfig"
UBOOT_ENTRYPOINT = "0x20008000"
UBOOT_LOADADDRESS = "0x20008000"
UBOOT_ENV_SIZE = "0x4000"

AT91BOOTSTRAP_MACHINE ?= "sama5d27_som1_custom"

# Needed for FIT
# KERNEL_CLASSES += "kernel-fitimage"
# KERNEL_IMAGETYPE = "fitImage"
# MACHINE_ESSENTIAL_EXTRA_RDEPENDS = " dt-overlay-at91"
```
